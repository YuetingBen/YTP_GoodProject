LIN_description_file;
LIN_protocol_version = "2.1";
LIN_language_version = "2.1";
LIN_speed = 19.2 kbps;

Nodes {
  Master: LIN_Master, 1 ms, 0 ms ;
  Slaves: Yueting ;
}

Signals {
  YT_SENT_Position: 16, 0, Yueting, LIN_Master ;
}

Frames {
  YT_SENT: 3, Yueting, 8 {
    YT_SENT_Position, 0 ;
  }
}

Node_attributes {
  Yueting{
    LIN_protocol = "2.1" ;
    configured_NAD = 0xFF ;
    initial_NAD = 0xFF ;
    product_id = 0x0, 0x0, 255 ;
    P2_min = 50 ms ;
    ST_min = 0 ms ;
    N_As_timeout = 1000 ms ;
    N_Cr_timeout = 1000 ms ;
    configurable_frames {
      YT_SENT ;
    }
  }
}

Schedule_tables {
 ScheduleTable {
    YT_SENT delay 10 ms ;
  }
}
