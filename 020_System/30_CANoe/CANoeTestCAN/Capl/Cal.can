/*@!Encoding:936*/
includes
{
  
}

variables
{
  linmessage MASTER_CAL MASTER_CAL_Frame;
  msTimer calTimer;
  
  byte mode;
}

on key 'a'
{
  mode = 0;
  setTimer(calTimer, 1000);
}

on key 'b'
{
  linChangeSchedTable(1);
}

on key 'c'
{
  MASTER_CAL_Frame.byte(0) = 0x01;
  MASTER_CAL_Frame.byte(5) = 0xAA;
  output(MASTER_CAL_Frame);
}

on timer calTimer
{
word calibrationFirstPosArray[9] = {3975, 3613, 4059, 807, 3517, 536, 65535, 65535, 65535};
word calibrationSecondPosArray[9] = {3252, 3252, 2855, 2855, 687, 416, 65535, 65535, 65535};

  if(mode <= 8)
  {
    MASTER_CAL_Frame.byte(0) = mode;
    MASTER_CAL_Frame.byte(1) = (byte)calibrationFirstPosArray[mode];
    MASTER_CAL_Frame.byte(2) = (byte)(calibrationFirstPosArray[mode] >> 8);
      
    MASTER_CAL_Frame.byte(3) = (byte)calibrationSecondPosArray[mode];
    MASTER_CAL_Frame.byte(4) = (byte)(calibrationSecondPosArray[mode] >> 8);
    
    MASTER_CAL_Frame.byte(5) = 1;
    
    mode = mode + 1;
    output(MASTER_CAL_Frame);
  }
  else
  {
    MASTER_CAL_Frame.byte(5) = 0;
    output(MASTER_CAL_Frame);
  }
  
  setTimer(calTimer, 1000);
}
